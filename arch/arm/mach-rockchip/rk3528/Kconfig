## arch/arm/mach-rockchip/rk3528/Kconfig
```kconfig
if ROCKCHIP_RK3528

config TARGET_EVB_RK3528
	bool "EVB_RK3528"
	select BOARD_LATE_INIT
	help
	  RK3528 EVB is a evaluation board for Rockchp RK3528.

config TARGET_IXON_RK3528
	bool "IXON_RK3528"
	select BOARD_LATE_INIT
	help
	  RK3528 IXON IXRouter board.

config SYS_SOC
	default "rockchip"

config SYS_MALLOC_F_LEN
	default 0x400

source board/rockchip/evb_rk3528/Kconfig

endif
```
